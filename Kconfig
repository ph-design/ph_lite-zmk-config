## Kconfig
```kconfig
config PH_LITE_DONGLE_AT_CMD
    bool "PH Lite dongle USB CDC AT command interface"
    depends on ZMK_2G4_DONGLE
    depends on USB_CDC_ACM
    depends on SERIAL
    depends on UART_INTERRUPT_DRIVEN

config PH_LITE_DONGLE_AT_BOOTLOADER
    bool "PH Lite dongle AT bootloader command"
    depends on PH_LITE_DONGLE_AT_CMD
    depends on SOC_NRF52840
```

## boards/phdesign/ph_lite/Kconfig.ph_lite
```kconfig
# Copyright (c) 2025 Team PHDesign
# SPDX-License-Identifier: Apache-2.0

config BOARD_PH_LITE
	select SOC_NRF52840_QIAA
	imply RETAINED_MEM
	imply RETENTION
	imply RETENTION_BOOT_MODE
```

## boards/shields/PH-Dongle/Kconfig.defconfig
```kconfig
if SHIELD_PH_DONGLE

config ZMK_KEYBOARD_NAME
    default "PH-Dongle"

config ZMK_USB
    default y

config ZMK_BLE
    default n

endif
```

## boards/shields/PH60-SC_V2_EVO/Kconfig.defconfig
```kconfig
if SHIELD_PH60_SC_V2_EVO

config ZMK_KEYBOARD_NAME
    default "PH60-SC_V2_EVO"

endif
```
