## Kconfig
```kconfig
config PH_LITE_RECEIVER
    def_bool y
    depends on BOARD_PH_LITE_RECEIVER && ZMK_2G4_DONGLE
    select ZMK_2G4_DONGLE_EXTERNAL



config OT60_HAPTICS
    bool "OT60 right-side keypress haptics"
    depends on SHIELD_OT60 && HAPTICS_DRV2605
```

## boards/arm/ot60/Kconfig.board
```kconfig
# SPDX-License-Identifier: MIT
config BOARD_OT60
    bool "OT60"
    depends on SOC_NRF52840_QIAA
```

## boards/arm/ot60/Kconfig.defconfig
```kconfig
# SPDX-License-Identifier: MIT
if BOARD_OT60
config BOARD
    default "ot60"
if USB_DEVICE_STACK
config USB_NRFX
    default y
config USB_DEVICE_VID
    default 0x5048
config USB_DEVICE_MANUFACTURER
    default "Team PHDesign"
endif
config BT_CTLR
    default BT
endif
```

## boards/arm/ph_lite/Kconfig.defconfig
```kconfig
# Copyright (c) 2025 Team PHDesign
# SPDX-License-Identifier: MIT

if BOARD_PH_LITE

config BOARD
    default "ph_lite"

if USB_DEVICE_STACK

config USB_NRFX
    default y

config USB_DEVICE_VID
    default 0x5048

config USB_DEVICE_PID
    default 0xFF00

config USB_DEVICE_MANUFACTURER
    default "Team PHDesign"

endif # USB_DEVICE_STACK

config BT_CTLR
    default BT

# Zephyr 3.5 requires the WS2812 driver to be selected explicitly.
config WS2812_STRIP
    default y if SHIELD_PH60_SC_V2_EVO

endif # BOARD_PH_LITE
```

## boards/arm/ph_lite_receiver/Kconfig.board
```kconfig
# SPDX-License-Identifier: MIT

config BOARD_PH_LITE_RECEIVER
    bool "PH Lite Receiver"
    depends on SOC_NRF52840_QIAA
```

## boards/arm/ph_lite_receiver/Kconfig.defconfig
```kconfig
# SPDX-License-Identifier: MIT

if BOARD_PH_LITE_RECEIVER

config BOARD
    default "ph_lite_receiver"

endif
```

## boards/arm/ph_lite_receiver/ph_lite_receiver_defconfig
```kconfig
# SPDX-License-Identifier: MIT

CONFIG_SOC_SERIES_NRF52X=y
CONFIG_SOC_NRF52840_QIAA=y
CONFIG_BOARD_PH_LITE_RECEIVER=y
CONFIG_ARM_MPU=y
CONFIG_MPU_ALLOW_FLASH_WRITE=y
CONFIG_PINCTRL=y
CONFIG_USE_DT_CODE_PARTITION=y
CONFIG_BUILD_OUTPUT_UF2=y

CONFIG_ZMK_KEYBOARD_NAME="PH-dongle"
CONFIG_ZMK_USB=y
CONFIG_ZMK_BLE=n
CONFIG_ZMK_2G4_DONGLE=y
CONFIG_ZMK_HID_REPORT_TYPE_NKRO=y
CONFIG_ZMK_HID_CONSUMER_REPORT_USAGES_FULL=y
CONFIG_ZMK_HID_CONSUMER_REPORT_SIZE=6
CONFIG_ZMK_HID_INDICATORS=y
CONFIG_ZMK_POINTING=y
CONFIG_ZMK_SLEEP=n
CONFIG_ZMK_STUDIO=n

CONFIG_ZMK_ESB_MAX_PAYLOAD_LENGTH=32
CONFIG_ZMK_ESB_PIPE_COUNT=8
CONFIG_ZMK_ESB_TX_FIFO_SIZE=8
CONFIG_ZMK_ESB_RX_FIFO_SIZE=16
CONFIG_HARDWARE_DEVICE_CS_GENERATOR=y

CONFIG_SETTINGS=y
CONFIG_SETTINGS_NVS=y
CONFIG_FLASH=y
CONFIG_FLASH_MAP=y
CONFIG_FLASH_PAGE_LAYOUT=y
CONFIG_NVS=y

CONFIG_USB_HID_REPORTS=3
CONFIG_HID_INTERRUPT_EP_MPS=32
CONFIG_USB_HID_POLL_INTERVAL_MS=1
CONFIG_USB_COMPOSITE_DEVICE=y
CONFIG_USB_CDC_ACM=y
CONFIG_SERIAL=y
CONFIG_UART_INTERRUPT_DRIVEN=y
CONFIG_UART_LINE_CTRL=y
CONFIG_USB_DEVICE_VID=0x5048
CONFIG_USB_DEVICE_PID=0xFF11
CONFIG_USB_DEVICE_MANUFACTURER="Team PHDesign"
CONFIG_USB_DEVICE_PRODUCT="PH-dongle"

CONFIG_UART_CONSOLE=n
CONFIG_PWM=y
CONFIG_SYSTEM_WORKQUEUE_STACK_SIZE=4096
CONFIG_REBOOT=y
```

## boards/phdesign/ph_lite_evo/Kconfig.ph_lite_evo
```kconfig
# Copyright (c) 2025 Team PHDesign
# SPDX-License-Identifier: MIT

config BOARD_PH_LITE_EVO
    select SOC_NRF52840_QIAA
    imply RETAINED_MEM
    imply RETENTION
    imply RETENTION_BOOT_MODE
```

## boards/shields/OT60/Kconfig.defconfig
```kconfig
# SPDX-License-Identifier: MIT
if SHIELD_OT60
config ZMK_KEYBOARD_NAME
    default "OT60"
endif
```

## boards/shields/OT60/Kconfig.shield
```kconfig
# SPDX-License-Identifier: MIT
config SHIELD_OT60
    def_bool $(shields_list_contains,OT60)
```

## dts/bindings/behaviors/phdesign,ot60-haptics.yaml
```yaml
# SPDX-License-Identifier: MIT

description: Play a short OT60 haptic click on the selected actuator(s).
compatible: "phdesign,ot60-haptics"
include: one_param.yaml
```

## dts/bindings/haptics/ti,drv2605.yaml
```yaml
# Copyright (c) 2024 Cirrus Logic, Inc.
# SPDX-License-Identifier: Apache-2.0

description: |
  DRV2605 Haptic Driver for ERM and LRA with built-in library and smart-loop
  architecture.

compatible: "ti,drv2605"

include: i2c-device.yaml

properties:
  actuator-mode:
    required: true
    type: string
    enum:
      - "ERM"
      - "LRA"
  feedback-brake-factor:
    type: string
    enum:
      - "1X"
      - "2X"
      - "3X"
      - "4X"
      - "6X"
      - "8X"
      - "16X"
      - "DISABLED"
    default: "3X"
    description: |
      Selects the feedback gain ratio between braking gain and driving gain.
      According to the datasheet, a value of 2 ("3X") is valid for most
      actuators.
  loop-gain:
    type: string
    enum:
      - "LOW"
      - "MEDIUM"
      - "HIGH"
      - "VERY_HIGH"
    default: "HIGH"
    description: |
      Selects a loop gain for the feedback control. According to the datasheet,
      a value of 2 ("HIGH") is valid for most actuators.
  vib-rated-mv:
    type: int
    default: 3200
    description: |
      Sets the reference voltage for full-scale output during closed-loop
      operation. The default value is inherited from ti,drv260x.yaml in Linux.
  vib-overdrive-mv:
    type: int
    default: 3200
    description: |
      Sets a clamp so that the automatic overdrive is bounded. The default
      value is inherited from ti,drv260x.yaml in Linux.
  vib-frequency-hz:
    type: int
    default: 0
    description: |
      LRA resonant frequency in Hz (0 = unknown). Used for the DRIVE_TIME
      initial guess (half period), the LRA open-loop period (register 0x20)
      and the rated/clamp voltage equations (datasheet 8.5.2, Eq 5/7).
  lra-open-loop:
    type: boolean
    description: |
      Drive the LRA in open loop at OL_LRA_PERIOD (derived from
      vib-frequency-hz). Default is closed-loop auto-resonance, which is what
      the LRA ROM library is tuned for. Requires vib-frequency-hz.
  erm-open-loop:
    type: boolean
    description: |
      Drive the ERM in open loop (fixed drive, no automatic overdrive/braking).
      The datasheet recommends open loop for ERM with ROM library A (fixed
      overdrive). Default is closed loop (differs from the chip reset value).
  auto-cal-time:
    type: int
    enum:
      - 0
      - 1
      - 2
      - 3
    default: 2
    description: |
      Auto-calibration duration (CONTROL4.AUTO_CAL_TIME): 0=150-350ms,
      1=250-450ms, 2=500-700ms (chip default), 3=1000-1200ms. Must be long
      enough for the actuator to reach steady acceleration.
  drive-time:
    type: int
    default: 0
    description: |
      Raw CONTROL1.DRIVE_TIME[4:0] (LRA: n*0.1ms+0.5ms, ERM: n*0.2ms+1ms).
      0 = auto: derived from vib-frequency-hz (LRA half period), or the chip
      default 0x13 when the frequency is unknown.
  lra-blanking-time:
    type: int
    default: 1
    enum: [0, 1, 2, 3, 4, 5, 6, 7, 8, 9, 10, 11, 12, 13, 14, 15]
    description: |
      Raw LRA BLANKING_TIME[3:0]: 0=15us, 1=25us, 2=50us, 3=75us,
      4=90us, 5=105us, 6=120us, 7=135us, 8=150us, 9=165us,
      10=180us, 11=195us, 12=210us, 13=235us, 14=260us, 15=285us.
  lra-idiss-time:
    type: int
    default: 1
    enum: [0, 1, 2, 3, 4, 5, 6, 7, 8, 9, 10, 11, 12, 13, 14, 15]
    description: |
      Raw LRA IDISS_TIME[3:0], using the same timing table as
      lra-blanking-time. Default 1 preserves the chip's 25us reset value.
  en-gpios:
    type: phandle-array
    description: GPIO to enable and disable the device.
  in-trig-gpios:
    type: phandle-array
    description: |
      GPIO connected to the IN/TRIG pin (external trigger output, or test
      source for PWM input mode).
```

## evo-4.1/west.yml
```yaml
manifest:
  remotes:
    - name: ph-design
      url-base: https://github.com/ph-design
  projects:
    - name: zmk
      repo-path: zmks
      remote: ph-design
      revision: 057566772edcce4873f668455a6d913e9545a232
      path: zmk
      import: app/west.yml
  self:
    path: config
```
