#undef ZMK_BEHAVIORS_KEEP_ALL

#include <behaviors.dtsi>
#include <dt-bindings/zmk/keys.h>
#include <dt-bindings/zmk/kscan_mock.h>

&kscan0 {
    compatible = "zmk,kscan-mock";
    rows = <1>;
    columns = <1>;
    event-period = <1000>;
    events = <ZMK_MOCK_RELEASE(0, 0, 1000)>;
};

/ {
    keymap {
        compatible = "zmk,keymap";

        default_layer {
            bindings = <&none>;
        };
    };
};
