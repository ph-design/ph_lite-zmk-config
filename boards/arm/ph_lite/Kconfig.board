## boards/arm/ph_lite/Kconfig.board
```kconfig
# PH-Lite board configuration

# Copyright (c) 2025 Team PHDesign
# SPDX-License-Identifier: MIT

config BOARD_PH_LITE
    bool "PH-Lite"
    depends on SOC_NRF52840_QIAA
```

## boards/shields/s60test/Kconfig.defconfig
```kconfig
if SHIELD_S60TEST

config ZMK_KEYBOARD_NAME
    default "s60test"

config ZMK_LED_WIDGETS
    bool "LED indicator widgets support"
    default y
    select LED
    select PWM

if ZMK_LED_WIDGETS

config ZMK_LED_WIDGETS_MAX_WIDGET_NUM
    int "Maximum number of widgets per event type"
    default 2

config ZMK_LED_WIDGETS_INIT_PRIORITY
    int "LED widgets init priority"
    default 99

endif # ZMK_LED_WIDGETS

endif
```

## boards/shields/s60test/Kconfig.shield
```kconfig
# Copyright (c) 2025 Team PHDesign
# SPDX-License-Identifier: MIT

config SHIELD_S60TEST
	def_bool $(shields_list_contains,s60test)
```
