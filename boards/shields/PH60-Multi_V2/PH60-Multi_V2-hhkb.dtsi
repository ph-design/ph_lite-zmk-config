// HHKB (7u)
ph60_hhkb_layout: ph60_hhkb_layout {
  compatible = "zmk,physical-layout";
  display-name = "HHKB";
  transform = <&hhkb_transform>;
  kscan = <&kscan0>;
  keys = ROW0
       , ROW1_MAIN , ROW1_ANSI
       , ROW2_MAIN , ROW2_ANSI
       , ROW3
       , SPC_HHKB
       ;
};
