// WKL (winkeyless)
ph60_wkl_layout: ph60_wkl_layout {
  compatible = "zmk,physical-layout";
  display-name = "WKL";
  transform = <&wkl_transform>;
  kscan = <&kscan0>;
  keys = ROW0
       , ROW1_MAIN , ROW1_ANSI
       , ROW2_MAIN , ROW2_ANSI
       , ROW3
       , SPC_WKL
       ;
};
