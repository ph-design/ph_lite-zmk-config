// ISO
ph60_iso_layout: ph60_iso_layout {
  compatible = "zmk,physical-layout";
  display-name = "ISO";
  transform = <&iso_transform>;
  kscan = <&kscan0>;
  keys = ROW0
       , ROW1_MAIN , ROW1_ISO
       , ROW2_MAIN , ROW2_ISO
       , ROW3
       , SPC_ANSI
       ;
};
