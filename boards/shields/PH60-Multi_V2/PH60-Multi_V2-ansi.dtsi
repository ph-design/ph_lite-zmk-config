// ANSI
ph60_ansi_layout: ph60_ansi_layout {
  compatible = "zmk,physical-layout";
  display-name = "ANSI";
  transform = <&default_transform>;
  kscan = <&kscan0>;
  keys = ROW0
       , ROW1_MAIN , ROW1_ANSI
       , ROW2_MAIN , ROW2_ANSI
       , ROW3
       , SPC_ANSI
       ;
};
