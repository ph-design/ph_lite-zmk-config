// WK (winkey)
ph60_wk_layout: ph60_wk_layout {
  compatible = "zmk,physical-layout";
  display-name = "WK";
  transform = <&wk_transform>;
  kscan = <&kscan0>;
  keys = ROW0
       , ROW1_MAIN , ROW1_ANSI
       , ROW2_MAIN , ROW2_ANSI
       , ROW3
       , SPC_WK
       ;
};
